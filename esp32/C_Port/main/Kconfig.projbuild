## esp32/C_Port/main/Kconfig.projbuild
```kconfig
menu "Qualia WiFi"
    config ESP_WIFI_SSID
        string "WiFi SSID"
        default "YOUR_SSID"

    config ESP_WIFI_PASSWORD
        string "WiFi Password"
        default "YOUR_PASSWORD"
endmenu
```

## esp32/C_Port/sdkconfig.defaults
```kconfig
# Target
CONFIG_IDF_TARGET="esp32s3"

# CPU
CONFIG_ESP_DEFAULT_CPU_FREQ_MHZ_240=y

# PSRAM (OPI, 80MHz)
CONFIG_SPIRAM=y
CONFIG_SPIRAM_MODE_OCT=y
CONFIG_SPIRAM_SPEED_80M=y
CONFIG_SPIRAM_FETCH_INSTRUCTIONS=y
CONFIG_SPIRAM_RODATA=y

# WiFi credentials — override via menuconfig or hardcode
CONFIG_ESP_WIFI_SSID="yoshi's island"
CONFIG_ESP_WIFI_PASSWORD="10234567890123456789012354"

# WiFi
CONFIG_ESP_WIFI_STATIC_RX_BUFFER_NUM=16
CONFIG_ESP_WIFI_DYNAMIC_RX_BUFFER_NUM=64
CONFIG_ESP_WIFI_TX_BUFFER_TYPE=0
CONFIG_ESP_WIFI_STATIC_TX_BUFFER_NUM=16
CONFIG_ESP_WIFI_AMPDU_TX_ENABLED=y
CONFIG_ESP_WIFI_AMPDU_RX_ENABLED=y
CONFIG_ESP_WIFI_RX_BA_WIN=32
CONFIG_ESP_WIFI_IRAM_OPT=y
CONFIG_ESP_WIFI_RX_IRAM_OPT=y

# TCP/IP — larger window lets PC burst more data before stalling
CONFIG_LWIP_TCP_MSS=1460
CONFIG_LWIP_TCP_SND_BUF_DEFAULT=32768
CONFIG_LWIP_TCP_WND_DEFAULT=65535
CONFIG_LWIP_TCP_RECVMBOX_SIZE=64
CONFIG_LWIP_IRAM_OPTIMIZATION=y
CONFIG_LWIP_TCPIP_RECVMBOX_SIZE=64

# FreeRTOS
CONFIG_FREERTOS_HZ=1000

# LCD
CONFIG_LCD_RGB_ISR_IRAM_SAFE=y

# Logging
CONFIG_LOG_DEFAULT_LEVEL_INFO=y

# Partition table (default single factory)
# CONFIG_PARTITION_TABLE_SINGLE_APP=y
CONFIG_COMPILER_OPTIMIZATION_PERF=y

# Partition table
CONFIG_PARTITION_TABLE_CUSTOM=y
CONFIG_PARTITION_TABLE_CUSTOM_FILENAME="partitions.csv"
CONFIG_ESPTOOLPY_FLASHSIZE_16MB=y

# USB / TinyUSB (esp_tinyusb managed component)
CONFIG_TINYUSB_MSC_ENABLED=y
CONFIG_TINYUSB_MSC_BUFSIZE=4096
CONFIG_TINYUSB_CDC_ENABLED=y
CONFIG_TINYUSB_CDC_COUNT=1

# FAT filesystem (long filename support)
CONFIG_FATFS_LFN_HEAP=y
CONFIG_FATFS_MAX_LFN=127
```
